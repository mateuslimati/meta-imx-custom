## conf/machine/scorpion-imx.conf
```bitbake
#@TYPE: Machine
#@NAME: Scorpion
#@SOC: i.MX7D
#@DESCRIPTION: Machine configuration for Scorpion board.

MACHINEOVERRIDES =. "mx7:mx7d:"

require conf/machine/include/imx-base.inc
require conf/machine/include/arm/armv7a/tune-cortexa7.inc

IMX_DEFAULT_BSP = "mainline"
IMX_DEFAULT_BOOTLOADER = "u-boot-fslc"

SERIAL_CONSOLES = "115200;ttymxc4"

KERNEL_DEVICETREE = " \
    imx7d-pico-pi.dtb \
"

SPL_BINARY = "SPL"
UBOOT_BINARY = "u-boot-dtb.img"
UBOOT_SUFFIX = "img"
UBOOT_MAKE_TARGET = ""

UBOOT_CONFIG ??= "pi"
UBOOT_CONFIG[pi] = "pico-pi-imx7d_defconfig"

UBOOT_EXTLINUX = "1"
UBOOT_EXTLINUX_ROOT = "root=/dev/mmcblk2p2"
UBOOT_EXTLINUX_CONSOLE = "console=${console},${baudrate}"

MACHINE_ESSENTIAL_EXTRA_RDEPENDS += " \
    kernel-image \
    kernel-devicetree \
    u-boot-fslc \
"

MACHINE_EXTRA_RRECOMMENDS += " \
  linux-firmware-ath10k \
"

WKS_FILES ?= "imx-uboot-spl.wks.in"
WKS_FILE_DEPENDS ?= ""
IMAGE_FSTYPES = "wic.bmap wic.xz ext4.gz"
```
